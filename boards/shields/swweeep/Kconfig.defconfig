## boards/shields/swweeep/Kconfig.defconfig
```kconfig
config ZMK_SPLIT
    default y

config ZMK_KEYBOARD_NAME
    default "Swweeep"


if SHIELD_SWWEEEP_LEFT || SHIELD_SWWEEEP_RIGHT

config ZMK_SLEEP
       default y

endif
```

## boards/shields/swweeep/Kconfig.shield
```kconfig
config SHIELD_SWWEEEP_DONGLE
    def_bool $(shields_list_contains,swweeep_dongle)

config SHIELD_SWWEEEP_LEFT
    def_bool $(shields_list_contains,swweeep_left)

config SHIELD_SWWEEEP_RIGHT
    def_bool $(shields_list_contains,swweeep_right)
```
